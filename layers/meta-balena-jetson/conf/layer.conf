## layers/meta-balena-jetson/conf/layer.conf
```bitbake
BBPATH .= ":${LAYERDIR}"

BBFILES += "${LAYERDIR}/recipes-*/*/*.bb \
            ${LAYERDIR}/recipes-*/*/*.bbappend"

BBFILE_COLLECTIONS += "balena-jetson"
BBFILE_PATTERN_balena-jetson := "^${LAYERDIR}/"
BBFILE_PRIORITY_balena-jetson = "1337"

# kernel-image is installed by meta-tegra. We use kernel-image-initramfs
# Remove kernel-image package
MACHINE_ESSENTIAL_EXTRA_RDEPENDS:remove = "kernel-image"
MACHINE_ESSENTIAL_EXTRA_RRECOMMENDS += "tegra-nvpmodel tegra-configs-udev"

LAYERSERIES_COMPAT_balena-jetson = "wrynose"
LAYERSERIES_COMPAT_tegra = "wrynose"

SERIAL_CONSOLES = "115200;ttyTCU0"
KERNEL_IMAGETYPES = "Image"
KERNEL_IMAGETYPE = "Image"
PARTITION_TABLE_TYPE = "gpt"

MACHINE_ESSENTIAL_EXTRA_RDEPENDS:remove = "tegra-firmware"
```
