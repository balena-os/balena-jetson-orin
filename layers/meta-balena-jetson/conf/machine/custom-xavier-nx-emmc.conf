## layers/meta-balena-jetson/conf/machine/custom-xavier-nx-emmc.conf
```bitbake
#@TYPE: Machine
#@NAME: Custom eMMC
##@DESCRIPTION: Custom carrier Board for Nvidia Jetson Xavier NX eMMC
#

MACHINEOVERRIDES = "jetson-xavier-nx-devkit-emmc:${MACHINE}"
include conf/machine/jetson-xavier-nx-devkit-emmc.conf

# work-around for https://github.com/OE4T/meta-tegra/issues/400
MACHINEOVERRIDES := "${@'${MACHINEOVERRIDES}'.replace(':${MACHINE}',':jetson-xavier-nx-devkit-emmc:${MACHINE}')}"

# Uncomment this only if the dtb needs to be rebuilt.
KERNEL_DEVICETREE = "tegra194-p3668-all-p3509-0000.dtb \
 tegra194-p3668-custom-0000.dtb \
"
```

## layers/meta-balena-jetson/conf/machine/forecr-dsb-ornx-lan-orin-nano-8gb.conf
```bitbake
#@TYPE: Machine
#@NAME: Forecr DSBOARD-ORNX-LAN / Jetson Orin Nano 8GB
##@DESCRIPTION: Forecr DSBOARD-ORNX-LAN carrier board with Orin Nano 8GB
#

MACHINEOVERRIDES = "forecr-dsb-ornx-lan-orin-nano-8gb:forecr-dsb-ornx-lan-orin-nano:forecr-dsb-ornx-lan"
# orin-nano.inc will prepend "orin-nano" to MACHINEOVERRIDES

# Refer to meta-tegra/conf/machine/p3768-0000-p3767-0004.conf for the following values
# Orin Nano 8GB is the default Nano in conf/machine/jetson-orin-nano-devkit-nvme.conf

TNSPEC_BOOTDEV ?= "nvme0n1p1"

PARTITION_LAYOUT_TEMPLATE_DEFAULT ?= "flash_t234_qspi.xml"
PARTITION_LAYOUT_TEMPLATE_DEFAULT_SUPPORTS_REDUNDANT ?= "1"
PARTITION_LAYOUT_EXTERNAL_DEFAULT ?= "flash_l4t_t234_nvme.xml"
TEGRAFLASH_NO_INTERNAL_STORAGE = "1"

# BOARDID-BOARDSKU
# p3767-0003 = Orin Nano 8GB
# p3767-0004 = Orin Nano 4GB
# p3767-0005 = Orin Nano 8GB + SD (devkit version)
#
# see https://docs.nvidia.com/jetson/archives/r36.2/DeveloperGuide/index.html#devices-supported-by-this-document

TEGRA_BOARDSKU = "0003"
KERNEL_DEVICETREE ?= "tegra234-p3768-0000+p3767-0003-nv.dtb"
# use defaults from orin-nano.inc for the 8GB SKU
# NVPMODEL ?= "nvpmodel_p3767_0003"
# EMMC_BCT ?= "tegra234-p3767-0001-sdram-l4t.dts"

require conf/machine/include/orin-nano.inc
require conf/machine/include/devkit-wifi.inc
```

## layers/meta-balena-jetson/conf/machine/forecr-dsb-ornx-orin-nano-4gb.conf
```bitbake
#@TYPE: Machine
#@NAME: Forecr DSBOARD ORNX / Jetson Orin Nano 4GB
##@DESCRIPTION: ForeCR DSB ORNX carrier board with Orin Nano 4GB
#

MACHINEOVERRIDES = "forecr-dsb-ornx-orin-nano-4gb:forecr-dsb-ornx-orin-nano:forecr-dsb-ornx"
# orin-nano.inc will prepend "orin-nano" to MACHINEOVERRIDES

# Refer to meta-tegra/conf/machine/p3768-0000-p3767-0004.conf for the following values
# Orin Nano 8GB is the default Nano in conf/machine/jetson-orin-nano-devkit-nvme.conf

TNSPEC_BOOTDEV ?= "nvme0n1p1"

PARTITION_LAYOUT_TEMPLATE_DEFAULT ?= "flash_t234_qspi.xml"
PARTITION_LAYOUT_TEMPLATE_DEFAULT_SUPPORTS_REDUNDANT ?= "1"
PARTITION_LAYOUT_EXTERNAL_DEFAULT ?= "flash_l4t_t234_nvme.xml"
TEGRAFLASH_NO_INTERNAL_STORAGE = "1"

# BOARDID-BOARDSKU
# p3767-0003 = Orin Nano 8GB
# p3767-0004 = Orin Nano 4GB
# p3767-0005 = Orin Nano 8GB + SD (devkit version)
#
# see https://docs.nvidia.com/jetson/archives/r36.2/DeveloperGuide/index.html#devices-supported-by-this-document

TEGRA_BOARDSKU = "0004"
KERNEL_DEVICETREE ?= "tegra234-p3768-0000+p3767-0004-nv.dtb"
# Use the values from p3768-0000-p3767-0004.conf for the 4GB SKU
NVPMODEL ?= "nvpmodel_p3767_0004"
EMMC_BCT ?= "tegra234-p3767-0004-sdram-l4t.dts"

require conf/machine/include/orin-nano.inc
require conf/machine/include/devkit-wifi.inc
```

## layers/meta-balena-jetson/conf/machine/forecr-dsb-ornx-orin-nano-8gb.conf
```bitbake
#@TYPE: Machine
#@NAME: Forecr DSBOARD-ORNX-LAN / Jetson Orin Nano 8GB
##@DESCRIPTION: Forecr DSBOARD-ORNX-LAN carrier board with Orin Nano 8GB
#

# Refer to meta-tegra/conf/machine/p3768-0000-p3767-0004.conf for the following values
# Orin Nano 8GB is the default Nano in conf/machine/jetson-orin-nano-devkit-nvme.conf

# BOARDID-BOARDSKU
# p3767-0003 = Orin Nano 8GB
# p3767-0004 = Orin Nano 4GB
# p3767-0005 = Orin Nano 8GB + SD (devkit version)
#
# see https://docs.nvidia.com/jetson/archives/r36.2/DeveloperGuide/index.html#devices-supported-by-this-document

MACHINEOVERRIDES = "jetson-orin-nano-devkit-nvme:${MACHINE}:"

include conf/machine/jetson-orin-nano-devkit-nvme.conf

KERNEL_DEVICETREE = "tegra234-p3768-0000+p3767-0003-nv.dtb"

MACHINEOVERRIDES := "${@'${MACHINEOVERRIDES}'.replace(':${MACHINE}',':jetson-orin-nano-devkit-nvme:${MACHINE}')}"
```

## layers/meta-balena-jetson/conf/machine/forecr-dsb-ornx-orin-nx-16gb.conf
```bitbake
#@TYPE: Machine
#@NAME: Forecr DSBOARD ORNX / Jetson Orin NX 16GB
#@DESCRIPTION: Forecr DSB ORN carrier board with Orin NX 16GB

MACHINEOVERRIDES = "forecr-dsb-ornx-orin-nx-16gb:forecr-dsb-ornx-orin-nx:forecr-dsb-ornx"

TEGRA_BOARDID ?= "3767"
TEGRA_FAB ?= "ES1"
TEGRA_BOARDSKU ?= "0000"
TEGRA_BOARDREV ?= "A.3"
TEGRA_CHIPREV ?= "1"
NVPMODEL ?= "nvpmodel_p3767_0000"
NVFANCONTROL ?= "nvfancontrol_p3767_0000"

TNSPEC_BOOTDEV ?= "nvme0n1p1"
PARTITION_LAYOUT_TEMPLATE_DEFAULT ?= "flash_t234_qspi.xml"
PARTITION_LAYOUT_TEMPLATE_DEFAULT_SUPPORTS_REDUNDANT ?= "1"
PARTITION_LAYOUT_EXTERNAL_DEFAULT ?= "flash_l4t_t234_nvme.xml"
TEGRAFLASH_NO_INTERNAL_STORAGE = "1"

require conf/machine/include/tegra234.inc
require conf/machine/include/devkit-wifi.inc

# Refer to meta-tegra/conf/machine/p3768-0000-p3767-0000.conf
# Everything bootloader-related happens outside of the build tree
# in Balena so there is no point bringing in variables like
# ODMDATA, TEGRA_FLASHVAR_* etc.

KERNEL_DEVICETREE ?= "tegra234-p3768-0000+p3767-0000-nv.dtb"
KERNEL_ARGS ?= "mminit_loglevel=4 console=ttyTCU0,115200 firmware_class.path=/etc/firmware fbcon=map:0 net.ifnames=0 nospectre_bhb video=efifb:off console=tty0"
MACHINE_EXTRA_RRECOMMENDS += "kernel-module-r8168 kernel-module-r8169 kernel-module-realtek"
MACHINE_EXTRA_RDEPENDS += "linux-firmware-rtl8168"

EMMC_SIZE ?= ""
BOOTPART_SIZE ?= "8388608"
# 55GiB default rootfs size
ROOTFSPART_SIZE_DEFAULT ?= "59055800320"
TEGRA_AUDIO_DEVICE ?= "tegra-hda-p3767-p3509"

OTABOOTDEV ?= "/dev/mtdblock0"
OTAGPTDEV ?= "/dev/mtdblock0"

TEGRA_PLUGIN_MANAGER_OVERLAYS ?= "tegra234-carveouts.dtbo tegra-optee.dtbo tegra234-p3768-0000+p3767-0000-dynamic.dtbo"
```

## layers/meta-balena-jetson/conf/machine/jetson-agx-orin-devkit-64gb.conf
```bitbake
#@TYPE: Machine
#@NAME: Jetson AGX Orin Devkit 64GB
##@DESCRIPTION: Yocto machine for Jetson AGX Orin Devkit 64GB
#

MACHINEOVERRIDES = "p3737-0000-p3701-0005:${MACHINE}"
include conf/machine/p3737-0000-p3701-0005.conf

# work-around for https://github.com/OE4T/meta-tegra/issues/400
MACHINEOVERRIDES := "${@'${MACHINEOVERRIDES}'.replace(':${MACHINE}',':p3737-0000-p3701-0005:${MACHINE}')}"
```

## layers/meta-balena-jetson/conf/machine/jetson-orin-nano-devkit-nvme.conf
```bitbake
#@TYPE: Machine
#@NAME: Nvidia Jetson Orin Nano devkit
#@DESCRIPTION: Nvidia Jetson Orin Nano devkit using NVMe drive for rootfs

MACHINEOVERRIDES =. "jetson-orin-nano-devkit:"
TNSPEC_BOOTDEV ?= "nvme0n1p1"

require conf/machine/include/orin-nano.inc
require conf/machine/include/devkit-wifi.inc
```

## layers/meta-balena-jetson/conf/machine/jetson-orin-nano-seeed-j3010.conf
```bitbake
#@TYPE: Machine
#@NAME: Jetson Orin Nano in Seeed Recomputer J3010
##@DESCRIPTION: Jetson Orin Nano 4GB / Seeed J401 carrier board
#

MACHINEOVERRIDES = "p3768-0000-p3767-0004:${MACHINE}:"
include conf/machine/p3768-0000-p3767-0004.conf

# work-around for https://github.com/OE4T/meta-tegra/issues/400
MACHINEOVERRIDES := "${@'${MACHINEOVERRIDES}'.replace(':${MACHINE}',':p3768-0000-p3767-0004:${MACHINE}')}"
```

## layers/meta-balena-jetson/conf/machine/jetson-orin-nx-seeed-j4012.conf
```bitbake
#@TYPE: Machine
#@NAME: Jetson Orin NX in Seeeed Recomputer J4012 
##@DESCRIPTION: Jetson Orin NX in Xavier NX Devkit carrier board
#

MACHINEOVERRIDES = "jetson-orin-nx-xavier-nx-devkit:${MACHINE}:"
include conf/machine/jetson-orin-nx-xavier-nx-devkit.conf

# work-around for https://github.com/OE4T/meta-tegra/issues/400
MACHINEOVERRIDES := "${@'${MACHINEOVERRIDES}'.replace(':${MACHINE}',':jetson-orin-nx-xavier-nx-devkit:${MACHINE}')}"
```

## layers/meta-balena-jetson/conf/machine/jetson-orin-nx-xavier-nx-devkit.conf
```bitbake
#@TYPE: Machine
#@NAME: Jetson Orin NX in Xavier NX Devkit
##@DESCRIPTION: Jetson Orin NX in Xavier NX Devkit carrier board
#

MACHINEOVERRIDES = "p3509-a02-p3767-0000:${MACHINE}"
include conf/machine/p3509-a02-p3767-0000.conf

# work-around for https://github.com/OE4T/meta-tegra/issues/400
MACHINEOVERRIDES := "${@'${MACHINEOVERRIDES}'.replace(':${MACHINE}',':p3509-a02-p3767-0000:${MACHINE}')}"
```

## layers/meta-nvidia-container-block/conf/layer.conf
```bitbake
BBPATH .= ":${LAYERDIR}"
BBFILES += "${LAYERDIR}/recipes-*/*/*.bb ${LAYERDIR}/recipes-*/*/*.bbappend"
BBFILE_COLLECTIONS += "meta-nvidia-container-block"
BBFILE_PATTERN_meta-nvidia-container-block = "^${LAYERDIR}/"
LAYERSERIES_COMPAT_meta-nvidia-container-block = "scarthgap"

# Enable DISTRO_FEATUREs gated by meta-tegra recipes we depend on.
#  - virtualization: nvidia-container-toolkit (CDI hook subpackage)
#  - opengl: tegra-libraries-camera + multimedia* + omx (referenced by
#    drivers.csv for V4L2 / camera / video pipelines)
# x11 stays disabled (balena is headless) — tegra-libraries-glxcore is
# excluded from IMAGE_INSTALL since GLX is X11-only.
# vulkan stays disabled — tegra-libraries-vulkan is excluded; not needed
# for the CUDA-runtime PoC.
DISTRO_FEATURES:append = " virtualization opengl"

# Pull in meta-tegra's external nvidia-container-toolkit recipe only.
# A wider glob also picks up docker/docker-moby_%.bbappend which depends
# on meta-virtualization being present (it isn't).
BBFILES += "${LAYERDIR}/../meta-tegra/external/virtualization-layer/recipes-containers/nvidia-container-toolkit/nvidia-container-toolkit_*.bb"
BBFILES += "${LAYERDIR}/../meta-tegra/external/virtualization-layer/recipes-containers/libnvidia-container/libnvidia-container_*.bb"

# Override LIBGLVND_PROVIDER selection from meta-tegra's
# `conf/machine/include/tegra-common.inc`. That file's conditional picks
# plain Yocto libglvnd when meta-openembedded is in BBLAYERS (which it is
# for us). Plain libglvnd builds GLES2 functionality via PACKAGECONFIG but
# does NOT declare `PROVIDES += "virtual/libgles2"`, so
# `tegra-libraries-camera` (which has `DEPENDS = "virtual/libgles2"`) fails
# to resolve a provider and is excluded from the image. libglvnd-tegra
# explicitly provides all virtual/{egl,libgl,libgles{1,2,3}} targets and
# RDEPENDS on tegra-libraries-{eglcore,glescore} which we already ship.
# `:forcevariable` is required because the machine .conf is parsed after
# our layer.conf and would otherwise re-run the conditional.
LIBGLVND_PROVIDER:forcevariable = "libglvnd-tegra"
```
